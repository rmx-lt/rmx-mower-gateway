## main/Kconfig.projbuild
```kconfig
menu "rmx gateway"

    comment "Identity: the client certificate in NVS (tools/provision_cert.ps1); its CN is the device name. No passwords."

    config GATEWAY_APN
        string "Cellular APN"
        default "internet"
        help
            APN of the SIM. "internet" for Tele2 LT / Pildyk.

    config GATEWAY_MQTT_CERT_URI
        string "MQTT broker URI (client certificate login)"
        default "mqtts://mqtt.rmx.lt:8884"
        help
            No password is sent; the broker takes the identity from the CN
            of the client certificate and forces client id = username.

    config GATEWAY_OTA_CONFIRM_S
        int "Seconds a new image has to reach MQTT before it rolls back"
        default 300
        range 60 3600

    config GATEWAY_OTA_MIN_CSQ
        int "Minimum signal (AT+CSQ, 0-31) to start an update"
        default 5
        range 0 31

    config GATEWAY_REC_MQTT_DOWN_S
        int "Seconds MQTT may stay down with PPP up before the cell redials"
        default 300
        range 60 86400
        help
            Recovery ladder step 1 (wiki Mower-Gateway-Architecture §4.3). Repeats
            every this many seconds while the condition lasts. Tuned with #16.

    config GATEWAY_REC_LINK_DOWN_S
        int "Seconds the server link may stay down before the gateway restarts"
        default 1800
        range 300 86400
        help
            Recovery ladder step 3. Never during a firmware update.

    config GATEWAY_LIVE_STALE_S
        int "Seconds a watched task may go without a loop before the gateway restarts"
        default 120
        range 30 3600

    config GATEWAY_TEST_CLOCK_SHIFT_DAYS
        int "TEST ONLY: shift the clock by this many days after SNTP"
        default 0
        range -36500 36500
        help
            Keep 0. Non-zero stops SNTP after the first sync and moves the clock,
            to check that TLS refuses the broker certificate (expired or not yet
            valid). Such a build never reaches MQTT and rolls back after an OTA.

    config GATEWAY_TEST_NTRIP_GGA
        bool "TEST ONLY: feed the NTRIP client a fixed GGA position"
        default n
        help
            Keep off. For a bench test without the autopilot: the NTRIP client
            gets a fixed position (a public place in Vilnius) at boot, so it
            connects to the caster as soon as it has settings.

endmenu
```
